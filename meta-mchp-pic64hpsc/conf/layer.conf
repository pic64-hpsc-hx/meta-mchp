## meta-mchp-pic64hpsc/conf/machine/include/pic64hpsc.inc
```bitbake
#@TYPE: Machine
#@NAME: pic64hpsc
#@DESCRIPTION: PIC64-HPSC/HX (High Performance Space Computer)

require conf/machine/include/riscv/tune-riscv.inc
require conf/machine/include/soc-family.inc

SOC_FAMILY = "pic64hpsc"
DEFAULTTUNE = "riscv64"

# Kernel
PREFERRED_PROVIDER_virtual/kernel:pic64hpsc = "linux-mchp-p64h"
PREFERRED_VERSION_linux-mchp = "6.12%"
KERNEL_IMAGETYPE = "Image"
KBUILD_DEFCONFIG ?= "p64h_defconfig"
# Don't include the kernel in /boot
RRECOMMENDS:${KERNEL_PACKAGE_NAME}-base = ""
```

## meta-mchp-pic64hpsc/conf/machine/pic64hpsc.conf
```bitbake
#@TYPE: Machine
#@NAME: pic64hpsc
#@DESCRIPTION: Generic support for PIC64-HPSC/HX

require include/pic64hpsc.inc

SERIAL_CONSOLES ?= "115200;ttyS0"

# Build as an initrd
IMAGE_FSTYPES += "cpio.gz"

# Build the bootloader and OpenSBI as part of the image.
EXTRA_IMAGEDEPENDS += "virtual/bootloader opensbi"

# VSC857x firmware
MACHINE_EXTRA_RRECOMMENDS += "linux-firmware-microchip"
```

## meta-mchp-pic64hpsc/recipes-bsp/opensbi/files/hpsc-defconfig
```kconfig
CONFIG_FDT_CACHE=y
CONFIG_FDT_CACHE_SIFIVE_CCACHE=y
CONFIG_FDT_HSM=y
CONFIG_FDT_HSM_SIFIVE_TMC0=y
CONFIG_FDT_IPI=y
CONFIG_FDT_IPI_MSWI=y
CONFIG_FDT_IRQCHIP=y
CONFIG_FDT_IRQCHIP_APLIC=y
CONFIG_FDT_IRQCHIP_IMSIC=y
CONFIG_FDT_MAILBOX=y
CONFIG_RPMI_MAILBOX=y
CONFIG_FDT_MAILBOX_RPMI_SHMEM=y
CONFIG_FDT_SERIAL=y
CONFIG_FDT_SERIAL_UART8250=y
CONFIG_FDT_TIMER=y
CONFIG_FDT_TIMER_MTIMER=y
CONFIG_FDT_MPXY=y
CONFIG_FDT_MPXY_RPMI_MBOX=y
CONFIG_FDT_MPXY_RPMI_CLOCK=y
CONFIG_FDT_MPXY_RPMI_SYSMSI=y
CONFIG_FDT_MPXY_RPMI_VOLTAGE=y
CONFIG_FDT_MPXY_RPMI_DEVICE_POWER=y
CONFIG_FDT_MPXY_RPMI_PERFORMANCE=y
```
